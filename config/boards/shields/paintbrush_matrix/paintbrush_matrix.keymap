/*
 * Copyright (c) 2020 The ZMK Contributors
 *
 * SPDX-License-Identifier: MIT
 */

#include <behaviors.dtsi>
#include <dt-bindings/zmk/keys.h>
#include <dt-bindings/zmk/bt.h>

#define ARDUX_LEFT 1

#define KEY_A 3
#define KEY_R 2
#define KEY_T 1
#define KEY_S 0

#define KEY_E 7
#define KEY_Y 6
#define KEY_I 5
#define KEY_O 4

#define LEADING_NONES NONE(0,0,0)
#define MIDDLE_NONES NONE(0,0,0)
#define TRAILING_NONES NONE(0,0,0)

#include "../../../ardux.dtsi"
